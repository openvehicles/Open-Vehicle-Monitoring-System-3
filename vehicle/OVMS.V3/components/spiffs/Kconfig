## vehicle/OVMS.V3/components/spiffs/Kconfig
```kconfig
menuconfig SPIFFS
    bool "SPIFFS"
    default n
    help
        Select this option to enable SPIFFS file system and show the submenu with SPIFFS features.

config SPIFFS_LOG_BLOCK_SIZE
    int "SPIFFS log block size"
    default 8192
    depends on SPIFFS
    help
        Size of SPIFFS log blocks.

config SPIFFS_LOG_PAGE_SIZE
    int "SPIFFS log page size"
    default 256
    depends on SPIFFS
    help
        Size of SPIFFS log pages.
```

## vehicle/OVMS.V3/components/vehicle_maxus_t90/Kconfig
```kconfig
menu "Vehicle: Maxus T90 EV"
config OVMS_VEHICLE_MAXUS_T90
    bool "Enable Maxus T90 EV"
    default y
    help
      Minimal vehicle module that polls SoC from 0x7e3/0x7eb PID 0xe002 and updates v.b.soc.
endmenu
```
